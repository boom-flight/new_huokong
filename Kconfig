## Kconfig
```kconfig
mainmenu "RT-Thread Configuration"

BSP_DIR := src/platform/board/stm32f103c8
RTT_DIR := vendor/rt-thread

config SOC_STM32F103C8
    bool
    select SOC_SERIES_STM32F1
    select RT_USING_COMPONENTS_INIT
    select RT_USING_USER_MAIN
    default y

config HUOKONG_FOXGLOVE_DEBUG
    bool "Enable Foxglove debug output on USART1"
    depends on BSP_USING_UART1
    default n

source "$(RTT_DIR)/Kconfig"
rsource "$(BSP_DIR)/soc/Kconfig"
rsource "$(BSP_DIR)/Kconfig"
```
